## configs/nanopc-t4-rk3399_defconfig
```kconfig
#
CONFIG_ARM=y
CONFIG_ARCH_ROCKCHIP=y
CONFIG_SYS_TEXT_BASE=0x00200000
CONFIG_NR_DRAM_BANKS=1
CONFIG_ENV_OFFSET=0x3F8000
CONFIG_DEFAULT_DEVICE_TREE="rk3399-nanopc-t4"
CONFIG_ROCKCHIP_RK3399=y
CONFIG_TARGET_EVB_RK3399=y
CONFIG_DEBUG_UART_BASE=0xFF1A0000
CONFIG_DEBUG_UART_CLOCK=24000000
CONFIG_DEBUG_UART=y
CONFIG_DEFAULT_FDT_FILE="rockchip/rk3399-nanopc-t4.dtb"
CONFIG_DISPLAY_BOARDINFO_LATE=y
# CONFIG_SPL_RAW_IMAGE_SUPPORT is not set
CONFIG_SPL_STACK_R=y
CONFIG_SPL_STACK_R_MALLOC_SIMPLE_LEN=0x10000
CONFIG_TPL=y
CONFIG_CMD_BOOTZ=y
CONFIG_CMD_GPT=y
CONFIG_CMD_MMC=y
CONFIG_CMD_PCI=y
# CONFIG_CMD_SETEXPR is not set
CONFIG_CMD_TIME=y
CONFIG_SPL_OF_CONTROL=y
CONFIG_OF_SPL_REMOVE_PROPS="pinctrl-0 pinctrl-names clock-names interrupt-parent assigned-clocks assigned-clock-rates assigned-clock-parents"
CONFIG_SYS_RELOC_GD_ENV_ADDR=y
CONFIG_ROCKCHIP_GPIO=y
CONFIG_SYS_I2C_ROCKCHIP=y
CONFIG_MMC_DW=y
CONFIG_MMC_DW_ROCKCHIP=y
CONFIG_MMC_SDHCI=y
CONFIG_MMC_SDHCI_ROCKCHIP=y
CONFIG_DM_ETH=y
CONFIG_ETH_DESIGNWARE=y
CONFIG_GMAC_ROCKCHIP=y
CONFIG_NVME=y
CONFIG_PCI=y
CONFIG_PMIC_RK8XX=y
CONFIG_REGULATOR_PWM=y
CONFIG_REGULATOR_RK8XX=y
CONFIG_PWM_ROCKCHIP=y
CONFIG_DM_RESET=y
CONFIG_BAUDRATE=1500000
CONFIG_DEBUG_UART_SHIFT=2
CONFIG_SYSRESET=y
CONFIG_DM_VIDEO=y
CONFIG_DISPLAY=y
CONFIG_VIDEO_ROCKCHIP=y
CONFIG_DISPLAY_ROCKCHIP_HDMI=y
CONFIG_DISPLAY_ROCKCHIP_EDP=y
CONFIG_SPL_TINY_MEMSET=y
CONFIG_ERRNO_STR=y

# SoM-RK3399v2
# -----------------------------------------------------------------------------
CONFIG_LOCALVERSION="asdf-2021.07-T4-patched-SPI"
CONFIG_RAM_RK3399_LPDDR4=y
# don't print:
# - drivers/ram/rockchip/sdram_common.c
# - drivers/ram/rockchip/sdram_rk3399.c
# Channel 0: LPDDR4, 50MHz
# BW=32 Col=10 Bk=8 CS0 Row=15 CS1 Row=15 CS=2 Die BW=16 Size=2048MB
# CONFIG_RAM_ROCKCHIP_DEBUG is not set

# SPI flash
# -----------------------------------------------------------------------------
CONFIG_ROCKCHIP_SPI=y
CONFIG_SF_DEFAULT_BUS=1
CONFIG_SF_DEFAULT_SPEED=20000000
# offset on which u-boot.itb is written (0x60000 = 384 kB = 96 * 4k sector):
CONFIG_SYS_SPI_U_BOOT_OFFS=0x60000
# CONFIG_ENV_IS_IN_SPI_FLASH=y
# CONFIG_ENV_SIZE=0x8000
# CONFIG_ENV_SECT_SIZE=0x1000
CONFIG_ENV_IS_IN_MMC=y
# store env in MMC1 which is SD card
CONFIG_SYS_MMC_ENV_DEV=1
CONFIG_SPL_SPI_FLASH_SUPPORT=y
CONFIG_SPL_SPI_SUPPORT=y
CONFIG_SPL_SPI_LOAD=y
CONFIG_SPI_FLASH=y
CONFIG_SPI_FLASH_GIGADEVICE=y
CONFIG_SPI_FLASH_WINBOND=y
CONFIG_SPL_DM_SEQ_ALIAS=y

# misc
# -----------------------------------------------------------------------------
CONFIG_PCI_INIT_R=y
CONFIG_CMD_NVME=y
CONFIG_CMD_ZFS=y
CONFIG_OF_LIBFDT_OVERLAY=y
CONFIG_CMD_GPIO=y
CONFIG_CMD_I2C=y
CONFIG_MISC=y
CONFIG_ROCKCHIP_EFUSE=y

# enable very early LED status
CONFIG_DEBUG_UART_BOARD_INIT=y
CONFIG_LED=y
CONFIG_LED_GPIO=y

# USB subsystem and keyboard
# -----------------------------------------------------------------------------
CONFIG_USB=y
CONFIG_USB_DWC3=y
CONFIG_USB_DWC3_GENERIC=y
# 210707: These two can be problematic (eg SPL doesn't boot):
CONFIG_PHY_ROCKCHIP_INNO_USB2=y
CONFIG_PHY_ROCKCHIP_TYPEC=y
# OHCI - USB1.1 only
# EHCI - USB2.0 + USB1.1
# XHCI - USB3.0 + USB2.0 + USB1.1
# INFO 210725 OHCI needed for USB2.0 hub to be recognized, Linux won't boot
# CONFIG_USB_OHCI_HCD=y
# CONFIG_USB_OHCI_GENERIC=y
CONFIG_USB_EHCI_HCD=y
CONFIG_USB_EHCI_GENERIC=y
CONFIG_USB_XHCI_HCD=y
# CONFIG_USB_XHCI_DWC3=y
CONFIG_USB_KEYBOARD=y
CONFIG_CMD_USB=y
# INFO 210708: disable USB storage, otherwise loading OS will panic. USB keyboard works
# CONFIG_USB_STORAGE is not set
CONFIG_SYS_USB_EVENT_POLL_VIA_INT_QUEUE=y
# needed for USB keyboard:
CONFIG_SYS_USB_EVENT_POLL=y

# LAN MAC from EEPROM
CONFIG_I2C_EEPROM=y
CONFIG_CMD_EEPROM=y
CONFIG_SYS_I2C_EEPROM_BUS=2
CONFIG_SYS_I2C_EEPROM_ADDR=0x51
CONFIG_SYS_I2C_EEPROM_ADDR_LEN=2
CONFIG_SYS_I2C_EEPROM_MAC_OFFSET=0xFA
CONFIG_SPL_I2C_SUPPORT=y
CONFIG_MISC_INIT_R=y
CONFIG_CMD_NET=y
CONFIG_ROCKCHIP_EFUSE=y
```
